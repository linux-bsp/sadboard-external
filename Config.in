## Config.in
```kconfig
menu "SadBoard troubleshooting labs"

source "$BR2_EXTERNAL_SADBOARD_PATH/package/sadboard-labs/Config.in"

endmenu
```

## package/sadboard-labs/Config.in
```kconfig
config BR2_PACKAGE_SADBOARD_LABS
    bool "SadBoard debugging scenarios"
    depends on BR2_USE_MMU
    help
      Install manually triggered debugging exercises, matching source code
      and reference repairs. No fault is triggered during system startup.
```
